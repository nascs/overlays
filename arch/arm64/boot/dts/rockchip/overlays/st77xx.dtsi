#ifndef __WAVESHARE35_LCD_DTSI__
#define __WAVESHARE35_LCD_DTSI__

#include <dt-bindings/gpio/gpio.h>
#include <dt-bindings/pinctrl/rockchip.h>
#include <dt-bindings/interrupt-controller/irq.h>

/dts-v1/;
/plugin/;

#ifndef DISPLAY_SPI
#error "DISPLAY_SPI is undefined."
#endif

&DISPLAY_SPI {
	status = "okay";
	#address-cells = <1>;
	#size-cells = <0>;

	st77xx: st77xx@0 {
		// compatible = "sitronix,st7735r";
		compatible = "sitronix,st7789v";
		reg = <0>;
		spi-max-frequency = <16000000>;
		txbuflen = <32768>;
		rotate = <90>;
		bgr = <0>;
		fps = <60>;
		width = <135>;
		height = <240>;
		buswidth = <8>;
		regwidth = <16>;
		debug = <0>;
	};

};

#endif // __WAVESHARE35_LCD_DTSI__
